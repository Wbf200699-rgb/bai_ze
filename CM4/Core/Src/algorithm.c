#include  <stdio.h>
#include  <math.h>
#include "instance.h"

int16_t pit                               =  0 ;
int32_t pdoa_1_temp[MAX_ANCHOR_LIST_SIZE] = {0};
int32_t pdoa_2_temp[MAX_ANCHOR_LIST_SIZE] = {0};

//const double cal_angles[CAL_NUM]={ -179.7431, -179.7431, -179.7431, -179.7431, -179.0675, -177.5259, -175.711, -175.5, -175.4841, -175.4186, -175.2454, -174.7263, -173.944,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 178.5, 178.5 };
//const double cal_values[CAL_NUM]={ -3.7431, -2.7431, -1.7431, -0.7431, -4.0675, -6.5259, -3.711, -2.5, -1.4841, -6.4186, -5.2454, -7.7263, -7.944,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 -1.5, -0.5 };

static double calib_aoa_linear(double current_aoa);
// -------------------------------------------------------------------------------------------------------------------
// Functions
// -------------------------------------------------------------------------------------------------------------------
double calc_aoa(uint8_t src, int16_t pdoa1, int16_t pdoa2)
{
#if 0 //HY ALGORITHM
    pdoa1 = pdoa1 + 1850;
    if(pdoa1 == 0 || pdoa2 == 0) return 0;
    
    if(pdoa1 >  6434) pdoa1 -= 12868;
    if(pdoa1 < -6434) pdoa1 += 12868;
    if(pdoa2 >  6434) pdoa2 -= 12868;
    if(pdoa2 < -6434) pdoa2 += 12868;
    
    if(fabs(pdoa2 - pdoa1) > 7000)
    {
        if (fabs(pdoa2) > fabs(pdoa1)) pdoa2 = (pdoa2 > 0) ? (pdoa2 - 12868) : (pdoa2 + 12868);
        else                           pdoa1 = (pdoa1 > 0) ? (pdoa1 - 12868) : (pdoa1 + 12868);
    }
    
    if(pdoa1 > 4500 && pdoa2 > 4500)
    {
        pdoa1 -= 12868;
        pdoa2 -= 12868;
    }
    
    if(pdoa1 > 6000) pdoa1 = -pdoa1;
    return calib_aoa_linear(-atan2(sqrt(3) * (double)pdoa1, 2 * (double)pdoa2 - (double)pdoa1) * (180 / 3.1415926));
#endif
#if 0
    int32_t pdoa_1 = pdoa1;
    int32_t pdoa_2 = pdoa2;
 //ZY ALGORITHM
    if(pdoa_1 != 0 && pdoa_2 != 0)
    {
    	if (fabs(pdoa_1 - pdoa_1_temp[src]) > 10000 || pdoa_1 > 4000)  pdoa_1 = pdoa_1 - 12868;
        pdoa_1 += 500;
    	pdoa_1_temp[src] = pdoa_1;

    	if (fabs(pdoa_2 - pdoa_2_temp[src]) > 10000 || pdoa_2 > 5000)  pdoa_2 = pdoa_2 - 12868;
    	pdoa_2_temp[src] = pdoa_2;
#else
        int32_t pdoa_1 = pdoa1;
        int32_t pdoa_2 = pdoa2;
        double PDOA1 = (double)pdoa1 / 6434.0 * M_PI;
        double PDOA2 = (double)pdoa2 / 6434.0 * M_PI;
 /*
        double freq = 6489.6e6;
        double lambda = 3e8 / freq;
        double dd = lambda / 2.0;
        double pdoa_th = 0.1 * M_PI;
        double lambda_term = (2.0 * M_PI) / lambda;

        double antenna_coords[3][2] = {
            {dd/(2.0*sqrt(3)), dd/2.0},
            {dd/(2.0*sqrt(3)), -dd/2.0},
            {-dd/sqrt(3), 0.0}
        };

        double antenna_relative_coords[2][2];
        antenna_relative_coords[0][0] = antenna_coords[1][0] - antenna_coords[0][0];
        antenna_relative_coords[0][1] = antenna_coords[1][1] - antenna_coords[0][1];
        antenna_relative_coords[1][0] = antenna_coords[2][0] - antenna_coords[0][0];
        antenna_relative_coords[1][1] = antenna_coords[2][1] - antenna_coords[0][1];
*/
    	double antenna_relative_coords[2][2] = {
    		{   0,  -0.0231},
			{-0.02, -0.0116}
    	};

        int ambi_options1[3][2] = {
            {-1, 0},
            {0,  1},
            {0,  0}
        };

        int ambi_options2[3][2] = {
            {1,  0},
            {0, -1},
            {0,  0}
        };

        double det = antenna_relative_coords[0][0] * antenna_relative_coords[1][1] -
                     antenna_relative_coords[0][1] * antenna_relative_coords[1][0];

        int (*ambi_options)[2] = (PDOA1 > PDOA2) ? ambi_options1 : ambi_options2;

        double wav_vec_err[3] = {0.0,0.0,0.0};
        for (int k = 0; k < 3; k++) {
            double tmp[2];
            tmp[0] = PDOA1 + 2.0 * M_PI * ambi_options[k][0];
            tmp[1] = PDOA2 + 2.0 * M_PI * ambi_options[k][1];

            double wav_vec[2];
            wav_vec[0] = ( antenna_relative_coords[1][1] * tmp[0] - antenna_relative_coords[0][1] * tmp[1]) / det;
            wav_vec[1] = (-antenna_relative_coords[1][0] * tmp[0] + antenna_relative_coords[0][0] * tmp[1]) / det;

            double norm = sqrt(wav_vec[0] * wav_vec[0] + wav_vec[1] * wav_vec[1]);
            wav_vec_err[k] = fabs(norm / 135.9179 /*lambda_term*/ - 1.0);
        }

        int mink = 0;
        double value = wav_vec_err[0];
        for (int k = 1; k < 3; k++) {
        	if (wav_vec_err[k] < value) {
        		value = wav_vec_err[k];
        		mink = k;
        	}
        }
        pdoa_1 += 12868 * ambi_options[mink][0];
        pdoa_2 += 12868 * ambi_options[mink][1];
#endif
        pit = acos(sqrt(2 * ((double)pdoa1 / 6434.0 * ((double)pdoa1 / 6434.0) + (double)pdoa2 / 6434.0 * ((double)pdoa2 / 6434.0) + (double)(pdoa1 - pdoa2) / 6434.0 * ((double)(pdoa1 - pdoa2) / 6434.0)) / 3 / 3.1415926)) * (180 / 3.1415926);
        double aoa =  -((int16_t)(-atan2(sqrt(3) * (double)pdoa_1, 2 * (double)pdoa_2 - (double)pdoa_1) * (180 / 3.1415926) + 600) % 360 - 180);
    	return *(uint8_t *)UWB_CONFIG_FILL1 != 0xff ? calib_aoa_linear(aoa) : aoa;
}

static int16_t closest_angles_index(double angles)
{
    int16_t left = 0, mid = 0, right = CAL_NUM - 1;

    while (left <= right) {
        mid = (left + right) >> 1;
        if (cal_angles[mid] == angles)
            return mid;
        else if (cal_angles[mid] < angles)
            left = mid + 1;
        else
            right = mid - 1;
    }
 //   if (left > CAL_NUM || right < 0)
 //       return CAL_NUM - 1; //both select scal_values 0
 //   else
        return ((cal_angles[left] - angles) < (angles - cal_angles[right])) ? left : right;
}

static double calib_aoa_linear(double current_aoa)
{
    double aoa_caled = 0; double cal = 0; int index = 0;

    if (current_aoa > cal_angles[CAL_NUM-1] && cal_angles[CAL_NUM-1] != 0)
        aoa_caled = 180;
    else if (current_aoa < cal_angles[0])
        aoa_caled = -180;
    else
    {
        index = closest_angles_index(current_aoa);
        cal   = cal_values[index];
        aoa_caled = current_aoa - cal;
    }
    if (aoa_caled > 180)
        aoa_caled = 180;
    else if (aoa_caled < -180)
        aoa_caled = -180;

    //uart2_printf(" %f, %d, %f, %f",current_aoa,index,cal,aoa_caled);
    return aoa_caled;
}

/**
 *  Calibration DIS Algorithm
 */
 typedef struct {
    float d;
    float v;
    float P[2][2];
    float Q[2];
    float R;
    float dt;
} KF_TWR_t;

/* One independent Kalman state per anchor (src index) so ranges of
 * different anchors do not pollute each other. */
static KF_TWR_t kf_twr[MAX_ANCHOR_LIST_SIZE];

void kf_twr_init(float dt) {
    for (uint8_t src = 0; src < MAX_ANCHOR_LIST_SIZE; src++) {
        KF_TWR_t *kf = &kf_twr[src];

        kf->d = 0.0f;
        kf->v = 0.0f;
        kf->dt = dt;

        kf->P[0][0] = 1.0f;
        kf->P[0][1] = 0.0f;
        kf->P[1][0] = 0.0f;
        kf->P[1][1] = 1.0f;

        kf->Q[0] = 0.001f;
        kf->Q[1] = 0.01f;
        kf->R    = 0.005f;
    }
}

static void kf_twr_predict(KF_TWR_t *kf) {
    float dt = kf->dt;

    // 状态预测
    float pred_d = kf->d + kf->v * dt;
    float pred_v = kf->v;

    // 协方差预测
    float p00 = kf->P[0][0];
    float p01 = kf->P[0][1];
    float p10 = kf->P[1][0];
    float p11 = kf->P[1][1];

    kf->P[0][0] = p00 + dt * p10 + dt * (p01 + dt * p11) + kf->Q[0];
    kf->P[0][1] = p01 + dt * p11;
    kf->P[1][0] = p10 + dt * p11;
    kf->P[1][1] = p11 + kf->Q[1];

    kf->d = pred_d;
    kf->v = pred_v;
}

float kf_twr_update(uint8_t src, float meas_d) {
    if (src >= MAX_ANCHOR_LIST_SIZE) return meas_d; //out of range: return raw measurement

    KF_TWR_t *kf = &kf_twr[src];
    kf_twr_predict(kf);

    // 卡尔曼增益
    float S = kf->P[0][0] + kf->R;
    float K0 = kf->P[0][0] / S;
    float K1 = kf->P[1][0] / S;

    // 残差
    float y = meas_d - kf->d;

    // 状态更新
    kf->d += K0 * y;
    kf->v += K1 * y;

    // 协方差更新
    float p00 = kf->P[0][0];
    float p01 = kf->P[0][1];

    kf->P[0][0] -= K0 * p00;
    kf->P[0][1] -= K0 * p01;
    kf->P[1][0] -= K1 * p00;
    kf->P[1][1] -= K1 * p01;

    return kf->d;
}

